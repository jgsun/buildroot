## configs/qemu_aarch64_virt-fun_defconfig
```kconfig
BR2_aarch64=y
BR2_cortex_a57=y
BR2_TOOLCHAIN_EXTERNAL=y
BR2_TARGET_GENERIC_GETTY_PORT="ttyAMA0"
BR2_SYSTEM_DHCP="eth0"
BR2_LINUX_KERNEL=y
BR2_LINUX_KERNEL_CUSTOM_VERSION=y
BR2_LINUX_KERNEL_CUSTOM_VERSION_VALUE="4.16.7"
BR2_LINUX_KERNEL_USE_CUSTOM_CONFIG=y
BR2_LINUX_KERNEL_CUSTOM_CONFIG_FILE="board/qemu/aarch64-virt/linux.config"
BR2_LINUX_KERNEL_NEEDS_HOST_OPENSSL=y
BR2_PACKAGE_LINUX_TOOLS_GPIO=y
BR2_PACKAGE_LINUX_TOOLS_PERF=y
BR2_PACKAGE_LINUX_TOOLS_PERF_TUI=y
BR2_PACKAGE_DROPBEAR=y
BR2_PACKAGE_ETHTOOL=y
BR2_TARGET_ROOTFS_CPIO_GZIP=y
BR2_TARGET_ROOTFS_INITRAMFS=y
# BR2_TARGET_ROOTFS_TAR is not set
BR2_PACKAGE_HOST_E2FSPROGS=y
```

## configs/qemu_arm_vexpress-fun_defconfig
```kconfig
BR2_arm=y
BR2_cortex_a9=y
BR2_ARM_ENABLE_NEON=y
BR2_ARM_ENABLE_VFP=y
BR2_TOOLCHAIN_BUILDROOT_GLIBC=y
BR2_PACKAGE_HOST_LINUX_HEADERS_CUSTOM_4_16=y
BR2_TARGET_GENERIC_GETTY_PORT="ttyAMA0"
BR2_SYSTEM_DHCP="eth0"
BR2_LINUX_KERNEL=y
BR2_LINUX_KERNEL_CUSTOM_VERSION=y
BR2_LINUX_KERNEL_CUSTOM_VERSION_VALUE="4.16.7"
BR2_LINUX_KERNEL_DEFCONFIG="vexpress"
BR2_LINUX_KERNEL_UIMAGE=y
BR2_LINUX_KERNEL_UIMAGE_LOADADDR="0x60003000"
BR2_LINUX_KERNEL_DTS_SUPPORT=y
BR2_LINUX_KERNEL_INTREE_DTS_NAME="vexpress-v2p-ca9"
BR2_PACKAGE_LINUX_TOOLS_PERF=y
BR2_PACKAGE_LINUX_TOOLS_PERF_TUI=y
BR2_PACKAGE_IPERF3=y
BR2_TARGET_ROOTFS_INITRAMFS=y
# BR2_TARGET_ROOTFS_TAR is not set
BR2_TARGET_UBOOT=y
BR2_TARGET_UBOOT_BOARD_DEFCONFIG="vexpress_ca9x4"
BR2_PACKAGE_HOST_E2FSPROGS=y
```

## package/boxing/linux-drivers/Config.in
```kconfig
config BR2_PACKAGE_LINUX_DRIVERS
	bool "linux-drivers"
	help
	  Linux kernel drivers.

if BR2_PACKAGE_LINUX_DRIVERS

config BR2_PACKAGE_LINUX_DRIVERS_TEST_DRIVERS
	bool "Build test drivers"
	help
	  In addition to standard target drivers, build a number of drivers
	  that can help in testing particular scenarios.
	  This option should not be enabled in target defconfigs.

endif
```

## package/ifstat/Config.in
```kconfig
config BR2_PACKAGE_IFSTAT
	bool "ifstat"
	help
	  ifstat is a tool to report network interface bandwith just
	  like vmstat/iostat do for other system counters. It can monitor
	  local interfaces by polling the kernel counters, or remote
	  hosts' interfaces using SNMP.

	  http://gael.roualland.free.fr/ifstat/
	  http://freshmeat.sourceforge.net/projects/ifstat

comment "ifstat is good for you"
```

## package/ply/Config.in
```kconfig
config BR2_PACKAGE_PLY_ARCH_SUPPORTS
	bool
	default y if BR2_aarch64
	default y if BR2_arm
	default y if BR2_powerpc
	default y if BR2_x86_64

comment "ply needs a toolchain w/ dynamic library, headers >= 4.14"
	depends on BR2_PACKAGE_PLY_ARCH_SUPPORTS
	depends on BR2_USE_MMU
	depends on !BR2_TOOLCHAIN_HEADERS_AT_LEAST_4_14 || BR2_STATIC_LIBS

config BR2_PACKAGE_PLY
	bool "ply"
	depends on BR2_PACKAGE_PLY_ARCH_SUPPORTS
	depends on BR2_USE_MMU # fork()
	depends on BR2_TOOLCHAIN_HEADERS_AT_LEAST_4_14 # BPF_JLT
	depends on !BR2_STATIC_LIBS
	help
	  ply is a light-weight dynamic tracer for Linux. By means of
	  using the BPF it can attach probes to the linux kernel
	  (e. g. kprobes).

	  It's a small alternative to LLVM based tracers for embedded
	  systems.

	  When using debugfs needs to be mounted on /sys/kernel/debug.
config BR2_PACKAGE_PLY
	bool "ply"
	depends on BR2_x86_64 || BR2_aarch64 || BR2_arm || BR2_ppc # needs <cpuid.h>
	depends on BR2_TOOLCHAIN_USES_UCLIBC || BR2_TOOLCHAIN_USES_GLIBC
	help
	  ply dynamically instruments the running kernel to aggregate and
	  extract user-defined data. It compiles an input program to one or
	  more Linux bpf(2) binaries and attaches them to arbitrary points
	  in the kernel using kprobes and tracepoints.

	  https://wkz.github.io/ply/
```
